## Kconfig
```kconfig
menu "NVS Settings config"

    config SETTINGS_DATETIME_SUPPORT
        bool "Support date and time settings"
        default y

    config SETTINGS_TIMEZONE_SUPPORT
        bool "Support timezone settings"
        default y

    config SETTINGS_COLOR_SUPPORT
        bool "Support color settings"
        default y
    
    config SETTINGS_CALLBACK_SUPPORT
        bool "Support callbacks for settings"
        default y
        help
            Enable support for callback functions that are invoked when a setting is changed.

endmenu
```
